## moonbase/migrate-s3/main/Kconfig.projbuild
```kconfig
menu "MoonLight S3 migration"
    config MM_MIGRATE_PAUSE_S
        int "Pause seconds at recoverable migration boundaries"
        default 0
        range 0 3600
endmenu
```

## moonbase/migrate-s3/sdkconfig.defaults
```kconfig
CONFIG_COMPILER_OPTIMIZATION_SIZE=y
CONFIG_ESPTOOLPY_FLASHSIZE_8MB=y
CONFIG_PARTITION_TABLE_CUSTOM=y
CONFIG_PARTITION_TABLE_CUSTOM_FILENAME="../../esp32/partitions/esp32s3_n8r8.csv"
CONFIG_SPI_FLASH_DANGEROUS_WRITE_ALLOWED=y
CONFIG_ESP_MAIN_TASK_STACK_SIZE=16384
CONFIG_LWIP_IPV6=n
CONFIG_ESP_WIFI_ENTERPRISE_SUPPORT=n
CONFIG_ESP_WIFI_ENABLE_WPA3_SAE=n
CONFIG_MBEDTLS_PSA_CRYPTO_C=y
CONFIG_MBEDTLS_HARDWARE_ECC=n
```
